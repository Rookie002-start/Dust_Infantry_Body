## algorithm/Kconfig
```kconfig
config ALG_LQR_ESO
    bool "Single-axis LQR + ESO controller"
    default n
    help
      单轴 LQR + 三阶 ESO 力矩控制器（前馈 + LQR 反馈 + 扰动补偿 +
      偏置补偿 + 死区/软硬限幅/斜率限制），用于云台 yaw/pitch 力矩直驱。
      参考南京理工大学《单轴云台最优控制器设计》方案，见 algorithm/lqr_eso/。
```

## watchdog/Kconfig
```kconfig
menu "Watchdog supervisor"

config WDT_SUPERVISOR
	bool "Portable watchdog supervisor"
	default n
	select WATCHDOG
	help
	  Aggregate service heartbeats and feed the selected Zephyr watchdog.

config WDT_SUPERVISOR_FEED_PERIOD_MS
	int "Watchdog feed period (ms)"
	depends on WDT_SUPERVISOR
	default 50
	range 50 5000

config WDT_SUPERVISOR_TIMEOUT_MS
	int "Watchdog reset timeout (ms)"
	depends on WDT_SUPERVISOR
	default 2000
	range 200 60000

config WDT_SUPERVISOR_HEALTH_WARMUP_MS
	int "Watchdog health warm-up (ms)"
	depends on WDT_SUPERVISOR
	default 1000
	range 200 10000

config WDT_SUPERVISOR_PRE_RESET_CALLBACK
	bool "Enable watchdog pre-reset callback"
	depends on WDT_SUPERVISOR
	default n

config WDT_SUPERVISOR_PAUSE_IN_SLEEP
	bool "Pause watchdog in sleep"
	depends on WDT_SUPERVISOR
	default n

endmenu
```

## west.yml
```yaml
manifest:
  version: "1.0"

  remotes:
    - name: zephyrproject
      url-base: https://github.com/zephyrproject-rtos
    - name: hpmicro
      url-base: https://github.com/hpmicro
    - name: rookies
      url-base: https://github.com/Rookie002-start

  defaults:
    remote: rookies

  projects:
    - name: zephyr
      remote: zephyrproject
      revision: 1f6485eca25431b5ff27ce9a754218c9e559bbbb
      import: true

    - name: zephyr_user
      repo-path: Dust_Zephyr_Tree
      path: zephyr_user
      revision: 68251b9608292307da1d3a02a0ec0413d0f072f3

    - name: sdk_env
      remote: hpmicro
      path: Zephyr_HPMicro/sdk_env
      revision: 7b8cb8bb2f04f52353a6429bffb024f0a2867876
      submodules: true

    - name: sdk_glue
      remote: hpmicro
      repo-path: zephyr_sdk_glue
      path: Zephyr_HPMicro/sdk_glue
      revision: 1756cb8fbef2334d9ad89aef08a01233f8502919

    - name: sdk_glue_user
      repo-path: Dust_Zephyr_HPMicro_Tree
      path: Zephyr_HPMicro/sdk_glue_user
      revision: 9a5501921d11a2ad352b44e76d1a6c7eb479a6e4

  self:
    path: projects/Dust_Infantry_Body
```
